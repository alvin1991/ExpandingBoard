## apps/examples/commbridge/Kconfig
```kconfig
#
# For a description of the syntax of this configuration file,
# see the file kconfig-language.txt in the NuttX tools repository.
#

config EXAMPLES_COMMBRIDGE
	bool "communication bridge"
	default n
	---help---
		Enable the communication with fmu

if EXAMPLES_COMMBRIDGE

config EXAMPLES_COMMBRIDGE_PROGNAME
	string "Program name"
	default "commbridge"
	depends on BUILD_KERNEL
	---help---
		This is the name of the program that will be use when the NSH ELF
		program is installed.

config EXAMPLES_COMMBRIDGE_PRIORITY
	int "comm bridge task priority"
	default 100

config EXAMPLES_COMMBRIDGE_STACKSIZE
	int "comm bridge stack size"
	default 2048

endif
```
